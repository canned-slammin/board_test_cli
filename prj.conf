## CMakeLists.txt
```
# SPDX-License-Identifier: Apache-2.0

cmake_minimum_required(VERSION 3.20.0)
find_package(Zephyr REQUIRED HINTS $ENV{ZEPHYR_BASE})
project(board_test_cli)
```

## prj.conf
```kconfig
CONFIG_STDOUT_CONSOLE=y
CONFIG_PRINTK=y
CONFIG_GPIO=y
CONFIG_LOG=y
CONFIG_LOG_PRINTK=y
CONFIG_LOG_MODE_IMMEDIATE=y
CONFIG_PWM_LOG_LEVEL_DBG=y

CONFIG_SHELL=y

CONFIG_POLL=y
```

## src/cli_commands.c
```c
/*
TODO: test command()
parse input
create request message
create return message
put request message in queue
wait for return message in queue
print return and error
*/
```

## src/cli_handler.c
```c
/*
TODO
handler function()
(insert functionality here)

handler test_function()
parse parameters
return the message
*/
```

## src/cli_sync.c
```c
/*
TODO 
init?
enqueue_request
dequeue_request
enqueue_return
dequeue_return

*/
```
