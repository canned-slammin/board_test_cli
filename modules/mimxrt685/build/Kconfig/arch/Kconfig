## modules/mimxrt685/build/Kconfig/arch/Kconfig
```kconfig
# Load Zephyr Arch Kconfig descriptions.
osource "C:/Users/samburner/zephyrproject/zephyr/arch/x86/Kconfig"
osource "C:/Users/samburner/zephyrproject/zephyr/arch/xtensa/Kconfig"
osource "C:/Users/samburner/zephyrproject/zephyr/arch/sparc/Kconfig"
osource "C:/Users/samburner/zephyrproject/zephyr/arch/riscv/Kconfig"
osource "C:/Users/samburner/zephyrproject/zephyr/arch/posix/Kconfig"
osource "C:/Users/samburner/zephyrproject/zephyr/arch/nios2/Kconfig"
osource "C:/Users/samburner/zephyrproject/zephyr/arch/mips/Kconfig"
osource "C:/Users/samburner/zephyrproject/zephyr/arch/arm64/Kconfig"
osource "C:/Users/samburner/zephyrproject/zephyr/arch/arm/Kconfig"
osource "C:/Users/samburner/zephyrproject/zephyr/arch/arc/Kconfig"
```

## modules/mimxrt685/build/Kconfig/boards/Kconfig
```kconfig
# Load Zephyr board Kconfig descriptions.
osource "C:/Users/samburner/zephyrproject/zephyr/boards/nxp/mimxrt685_evk/Kconfig"
```

## modules/mimxrt685/build/Kconfig/boards/Kconfig.defconfig
```kconfig
# Load Zephyr board defconfig descriptions.
osource "C:/Users/samburner/zephyrproject/zephyr/boards/nxp/mimxrt685_evk/Kconfig.defconfig"
```

## modules/mimxrt685/build/Kconfig/boards/Kconfig.mimxrt685_evk
```kconfig
# Load board Kconfig descriptions.
osource "C:/Users/samburner/zephyrproject/zephyr/boards/nxp/mimxrt685_evk/Kconfig.mimxrt685_evk"
```

## modules/mimxrt685/build/Kconfig/boards/Kconfig.sysbuild
```kconfig
# Load Sysbuild board Kconfig descriptions.
osource "C:/Users/samburner/zephyrproject/zephyr/boards/nxp/mimxrt685_evk/Kconfig.sysbuild"
```
