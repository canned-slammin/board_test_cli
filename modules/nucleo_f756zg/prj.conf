## prj.conf
```kconfig
CONFIG_STDOUT_CONSOLE=y
CONFIG_PRINTK=y
CONFIG_GPIO=y
CONFIG_I2C=y
CONFIG_LOG=y
CONFIG_LOG_PRINTK=y
CONFIG_LOG_MODE_IMMEDIATE=y
CONFIG_PWM_LOG_LEVEL_DBG=y

CONFIG_SHELL=y
CONFIG_GPIO_SHELL=y
CONFIG_I2C_SHELL=y

CONFIG_POLL=y
```

## src/main.c
```c
#include "main.h"

int main(void) {
    return 0;
}
```
